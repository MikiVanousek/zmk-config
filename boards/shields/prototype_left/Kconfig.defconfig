## boards/shields/prototype_left/Kconfig.defconfig
```kconfig
# Copyright (c) 2020 The ZMK Contributors
# SPDX-License-Identifier: MIT

if SHIELD_prototype_LEFT

config ZMK_KEYBOARD_NAME
	default "prototype"

config ZMK_SPLIT_ROLE_CENTRAL
	default y

endif

if SHIELD_prototype_LEFT || SHIELD_prototype_RIGHT

config ZMK_SPLIT
	default y

endif
```

## config/Kconfig.shield
```kconfig
# Copyright (c) 2020 The ZMK Contributors
# SPDX-License-Identifier: MIT

config SHIELD_prototype_LEFT
	def_bool $(shields_list_contains,prototype_left)

config SHIELD_prototype_RIGHT
	def_bool $(shields_list_contains,prototype_right)
```
